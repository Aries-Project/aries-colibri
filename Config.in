## Config.in
```kconfig
menu "FABTotum"

	source "$BR2_EXTERNAL/package/Config.in"

endmenu

menu "Bundles"

	source "$BR2_EXTERNAL/bundle/Config.in"

endmenu
```

## bundle/Config.in
```kconfig
source "$BR2_EXTERNAL/bundle/core-bundle/Config.in"
source "$BR2_EXTERNAL/bundle/kernel-bundle/Config.in"
source "$BR2_EXTERNAL/bundle/extra-libs-bundle/Config.in"
source "$BR2_EXTERNAL/bundle/network-bundle/Config.in"
source "$BR2_EXTERNAL/bundle/python-bundle/Config.in"
source "$BR2_EXTERNAL/bundle/scientific-bundle/Config.in"
source "$BR2_EXTERNAL/bundle/tools-bundle/Config.in"
source "$BR2_EXTERNAL/bundle/web-bundle/Config.in"
source "$BR2_EXTERNAL/bundle/rpi-bundle/Config.in"
source "$BR2_EXTERNAL/bundle/multimedia-bundle/Config.in"
source "$BR2_EXTERNAL/bundle/development-bundle/Config.in"
```

## bundle/core-bundle/Config.in
```kconfig
config BR2_PACKAGE_CORE_BUNDLE
	select BR2_PACKAGE_DOSFSTOOLS
	select BR2_PACKAGE_DROPBEAR
	select BR2_PACKAGE_NANO
	select BR2_PACKAGE_NCURSES
	select BR2_PACKAGE_READLINE
	select BR2_PACKAGE_ZLIB
	select BR2_PACKAGE_SUDO
	bool "core-bundle"
```

## bundle/extra-libs-bundle/Config.in
```kconfig
config BR2_PACKAGE_EXTRA_LIBS_BUNDLE
	select BR2_PACKAGE_OPENSSL
	select BR2_PACKAGE_PCRE
	select BR2_PACKAGE_LIBXML2
	select BR2_PACKAGE_LIBYAML
	select BR2_PACKAGE_GETTEXT
	select BR2_PACKAGE_ICU
	select BR2_PACKAGE_LIBUSB
	select BR2_PACKAGE_LIBUSB_COMPAT
	select BR2_PACKAGE_LIBFFI
	select BR2_PACKAGE_ELFUTILS
	select BR2_PACKAGE_LIBDAEMON
	select BR2_PACKAGE_SQLITE
	bool "extra-libs-bundle"
```

## bundle/kernel-bundle/Config.in
```kconfig
config BR2_PACKAGE_KERNEL_BUNDLE
	select BR2_LINUX_KERNEL
	select BR2_PACKAGE_LINUX_FIRMWARE
	select BR2_PACKAGE_LINUX_FIRMWARE_RTL_8188
	select BR2_PACKAGE_LINUX_FIRMWARE_BRCM_BCM43XX
	select BR2_PACKAGE_LINUX_FIRMWARE_BRCM_BCM43XXX
	select BR2_PACKAGE_LINUX_FIRMWARE_BRCM_BCM43430
	bool "kernel-bundle"
```

## bundle/multimedia-bundle/Config.in
```kconfig
config BR2_PACKAGE_MULTIMEDIA_BUNDLE
	select BR2_PACKAGE_FFMPEG
	bool "multimedia-bundle"
```

## bundle/network-bundle/Config.in
```kconfig
config BR2_PACKAGE_NETWORK_BUNDLE
	select BR2_PACKAGE_LIBCURL
	select BR2_PACKAGE_LIBMCRYPT
	select BR2_PACKAGE_IFLUGD
	select BR2_PACKAGE_IPTABLES
	select BR2_PACKAGE_WIRELESS_TOOLS
	select BR2_PACKAGE_WPA_SUPPLICANT
	select BR2_PACKAGE_IFPLUGD
	select BR2_PACKAGE_IFUPDOWN
	select BR2_PACKAGE_IPTABLES
	select BR2_PACKAGE_GESFTPSERVER
	select BR2_PACKAGE_LIBTIRPC
	select BR2_PACKAGE_NFS_UTILS
	bool "network-bundle"
```

## bundle/python-bundle/Config.in
```kconfig
config BR2_PACKAGE_PYTHON_BUNDLE
	select BR2_PACKAGE_PYTHON3
	select BR2_PACKAGE_PYTHON_CFFI
	select BR2_PACKAGE_PYTHON_SERIAL
	select BR2_PACKAGE_PYTHON_RPI_GPIO
	select BR2_PACKAGE_PYTHON_NUMPY
	select BR2_PACKAGE_PYTHON_SCIPY
	select BR2_PACKAGE_PYTHON_REQUESTS
	select BR2_PACKAGE_PYTHON_PATHTOOLS
	select BR2_PACKAGE_PYTHON_PYYAML
	select BR2_PACKAGE_PYTHON_WATCHDOG
	bool "python-bundle"
```

## bundle/rpi-bundle/Config.in
```kconfig
config BR2_PACKAGE_RPI_BUNDLE
	select BR2_PACKAGE_RPU_USERLAND
	bool "rpi-bundle"
```

## bundle/tools-bundle/Config.in
```kconfig
config BR2_PACKAGE_TOOLS_BUNDLE
	select BR2_PACKAGE_CURA_ENGINE
	select BR2_PACKAGE_AVRDUDE
	select BR2_PACKAGE_STRACE
	bool "tools-bundle"
```

## bundle/web-bundle/Config.in
```kconfig
config BR2_PACKAGE_WEB_BUNDLE
	select BR2_PACKAGE_LIGHTTPD
	select BR2_PACKAGE_PHP
	bool "web-bundle"
```

## configs/aries_rpi3_defconfig
```kconfig
BR2_arm=y
BR2_armv6=y
BR2_ARM_EABIHF=y
BR2_WGET="wget --passive-ftp -nd -t 3 --no-check-certificate"
BR2_DL_DIR="$(TOPDIR)/../downloads"
BR2_OPTIMIZE_2=y
BR2_TOOLCHAIN_BUILDROOT_VENDOR="colibri"
BR2_KERNEL_HEADERS_3_12=y
BR2_TOOLCHAIN_BUILDROOT_GLIBC=y
BR2_GLIBC_VERSION_2_20=y
BR2_BINUTILS_VERSION_2_25=y
BR2_GCC_VERSION_4_9_X=y
BR2_EXTRA_GCC_CONFIG_OPTIONS="--enable-long-long "
BR2_TOOLCHAIN_BUILDROOT_CXX=y
BR2_TOOLCHAIN_BUILDROOT_F77=y
BR2_GCC_ENABLE_OPENMP=y
BR2_GCC_ENABLE_GRAPHITE=y
BR2_TARGET_GENERIC_HOSTNAME="colibri"
BR2_TARGET_GENERIC_ISSUE="Welcome to Colibri"
BR2_ROOTFS_DEVICE_CREATION_DYNAMIC_MDEV=y
BR2_TARGET_GENERIC_GETTY_PORT="tty1"
# BR2_TARGET_GENERIC_REMOUNT_ROOTFS_RW is not set
BR2_TARGET_TZ_INFO=y
BR2_TARGET_LOCALTIME="Europe/Rome"
BR2_TARGET_LOCALES=y
BR2_TARGET_LOCALE_GEN="$(BR2_EXTERNAL)/board/common/locale.gen"
BR2_ROOTFS_OVERLAY="$(BR2_EXTERNAL)/board/raspberrypi/v3/rootfs_overlay"
BR2_LINUX_KERNEL_CUSTOM_TARBALL=y
BR2_LINUX_KERNEL_CUSTOM_TARBALL_LOCATION="https://github.com/raspberrypi/linux/archive/raspberrypi-kernel_1.20160523-1.tar.gz"
BR2_LINUX_KERNEL_PATCH="$(BR2_EXTERNAL)/board/raspberrypi/v3/4.4.y"
BR2_LINUX_KERNEL_USE_CUSTOM_CONFIG=y
BR2_LINUX_KERNEL_CUSTOM_CONFIG_FILE="$(BR2_EXTERNAL)/board/raspberrypi/v3/linux-4.4.y-rpi.config"
BR2_LINUX_KERNEL_ZIMAGE=y
BR2_LINUX_KERNEL_INSTALL_SDCARD=y
BR2_LINUX2_KERNEL=y
BR2_LINUX2_KERNEL_CUSTOM_TARBALL=y
BR2_LINUX2_KERNEL_CUSTOM_TARBALL_LOCATION="https://github.com/raspberrypi/linux/archive/raspberrypi-kernel_1.20160523-1.tar.gz"
BR2_LINUX2_KERNEL_PATCH="$(BR2_EXTERNAL)/board/raspberrypi/v3/4.4.y"
BR2_LINUX2_KERNEL_USE_CUSTOM_CONFIG=y
BR2_LINUX2_KERNEL_CUSTOM_CONFIG_FILE="$(BR2_EXTERNAL)/board/raspberrypi/v3/linux-4.4.y-rpi3.config"
BR2_LINUX2_KERNEL_ZIMAGE=y
BR2_LINUX2_KERNEL_INSTALL_SDCARD=y
BR2_LINUX2_KERNEL_INSTALL_SDCARD_NAME="kernel7.img"
BR2_PACKAGE_BUSYBOX_CONFIG="$(BR2_EXTERNAL)/board/raspberrypi/v3/busybox.config"
BR2_PACKAGE_BUSYBOX_SHOW_OTHERS=y
BR2_PACKAGE_BUSYBOX_NTPD=y
BR2_PACKAGE_FFMPEG=y
BR2_PACKAGE_DOSFSTOOLS_FATLABEL=y
BR2_PACKAGE_DOSFSTOOLS_FSCK_FAT=y
BR2_PACKAGE_DOSFSTOOLS_MKFS_FAT=y
BR2_PACKAGE_E2FSPROGS=y
BR2_PACKAGE_LINUX_FIRMWARE_RTL_81XX=y
BR2_PACKAGE_LINUX_FIRMWARE_EXTRA=y
BR2_PACKAGE_RPI_FIRMWARE=y
BR2_PACKAGE_RPI_FIRMWARE_X=y
BR2_PACKAGE_RPI_FIRMWARE_CUSTOM_CONFIG=y
BR2_PACKAGE_RPI_FIRMWARE_CMDLINE_TXT="$(BR2_EXTERNAL)/board/raspberrypi/v3/cmdline.txt"
BR2_PACKAGE_RPI_FIRMWARE_CONFIG_TXT="$(BR2_EXTERNAL)/board/raspberrypi/v3/config.txt"
BR2_PACKAGE_FAKE_HWCLOCK=y
BR2_PACKAGE_PPS_TOOLS=y
BR2_PACKAGE_RPI_USERLAND=y
BR2_PACKAGE_RPI_USERLAND_START_VCFILED=y
BR2_PACKAGE_PHP_EXT_CALENDAR=y
BR2_PACKAGE_PHP_EXT_FILEINFO=y
BR2_PACKAGE_PHP_EXT_READLINE=y
BR2_PACKAGE_PHP_EXT_ZIP=y
BR2_PACKAGE_PHP_EXT_MCRYPT=y
BR2_PACKAGE_PHP_EXT_OPENSSL=y
BR2_PACKAGE_PHP_EXT_PDO=y
BR2_PACKAGE_PHP_EXT_PDO_SQLITE=y
BR2_PACKAGE_PHP_EXT_GETTEXT=y
BR2_PACKAGE_PHP_EXT_ICONV=y
BR2_PACKAGE_PHP_EXT_INTL=y
BR2_PACKAGE_PHP_EXT_MBSTRING=y
BR2_PACKAGE_PHP_EXT_JSON=y
BR2_PACKAGE_PHP_EXT_TOKENIZER=y
BR2_PACKAGE_PHP_EXT_CURL=y
BR2_PACKAGE_PHP_EXT_FTP=y
BR2_PACKAGE_PHP_EXT_SOCKETS=y
BR2_PACKAGE_PHP_EXT_CTYPE=y
BR2_PACKAGE_PHP_EXT_FILTER=y
BR2_PACKAGE_PHP_EXT_DOM=y
BR2_PACKAGE_PHP_EXT_SIMPLEXML=y
BR2_PACKAGE_PHP_EXT_XML=y
BR2_PACKAGE_PHP_EXT_XMLREADER=y
BR2_PACKAGE_PHP_EXT_XMLWRITER=y
BR2_PACKAGE_PHP_SAPI_CLI_CGI=y
BR2_PACKAGE_PYTHON3_SQLITE=y
BR2_PACKAGE_PYTHON_DJANGO=y
BR2_PACKAGE_PYTHON_HTTPLIB2=y
BR2_PACKAGE_PYTHON_PICAMERA=y
BR2_PACKAGE_PYTHON_SHAPELY=y
BR2_PACKAGE_OPENSSL_BIN=y
BR2_PACKAGE_OPENSSL_ENGINES=y
BR2_PACKAGE_SQLITE_READLINE=y
BR2_PACKAGE_SQLITE_ENABLE_FTS3=y
BR2_PACKAGE_SQLITE_ENABLE_UNLOCK_NOTIFY=y
BR2_PACKAGE_JPEG_TURBO=y
BR2_PACKAGE_OPENCV3=y
BR2_PACKAGE_OPENCV3_LIB_PYTHON=y
BR2_PACKAGE_OPENCV3_LIB_SHAPE=y
BR2_PACKAGE_OPENCV3_LIB_STITCHING=y
BR2_PACKAGE_OPENCV3_LIB_SUPERRES=y
BR2_PACKAGE_OPENCV3_LIB_VIDEOIO=y
BR2_PACKAGE_OPENCV3_LIB_VIDEOSTAB=y
BR2_PACKAGE_OPENCV3_WITH_JASPER=y
BR2_PACKAGE_OPENCV3_WITH_JPEG=y
BR2_PACKAGE_OPENCV3_WITH_PNG=y
BR2_PACKAGE_OPENCV3_WITH_V4L=y
BR2_PACKAGE_LIBV4L=y
BR2_PACKAGE_LIBV4L_UTILS=y
BR2_PACKAGE_PCRE_16=y
BR2_PACKAGE_PCRE_32=y
BR2_PACKAGE_PCRE_UCP=y
BR2_PACKAGE_AVAHI=y
BR2_PACKAGE_AVAHI_DAEMON=y
BR2_PACKAGE_LIGHTTPD_OPENSSL=y
BR2_PACKAGE_LIGHTTPD_ZLIB=y
BR2_PACKAGE_LIGHTTPD_BZIP2=y
BR2_PACKAGE_LIGHTTPD_PCRE=y
BR2_PACKAGE_WIRELESS_TOOLS_LIB=y
BR2_PACKAGE_WPA_SUPPLICANT_CLI=y
BR2_PACKAGE_WPA_SUPPLICANT_PASSPHRASE=y
BR2_PACKAGE_INOTIFY_TOOLS=y
BR2_PACKAGE_LOGROTATE=y
BR2_PACKAGE_DCRON=y
BR2_PACKAGE_KMOD=y
BR2_PACKAGE_KMOD_TOOLS=y
BR2_TARGET_ROOTFS_COLIBRI=y
BR2_TARGET_ROOTFS_COLIBRI_LZO=y
BR2_ROOTFS_REMOVE_DOCUMENTATION=y
BR2_ROOTFS_REMOVE_DEVELOPMENT=y
BR2_ROOTFS_INCLUDE_LEGAL_INFO=y
BR2_TARGET_COLIBRI_EARLYBOOT=y
BR2_TARGET_COLIBRI_EARLYBOOT_CUSTOM=y
BR2_TARGET_COLIBRI_EARLYBOOT_CUSTOM_WEBUI="$(BR2_EXTERNAL)/board/common/earlyboot/www"
BR2_TARGET_COLIBRI_EARLYBOOT_CUSTOM_CONFIG="$(BR2_EXTERNAL)/board/raspberrypi/v3/earlyboot/earlyboot.conf"
BR2_TARGET_COLIBRI_EARLYBOOT_CUSTOM_PRODUCT="$(BR2_EXTERNAL)/board/raspberrypi/v3/earlyboot/product.sh"
BR2_TARGET_COLIBRI_EARLYBOOT_SUPPORT_EXT4=y
BR2_TARGET_COLIBRI_EARLYBOOT_SUPPORT_BTRFS=y
BR2_PACKAGE_HOST_SQUASHFS=y
BR2_PACKAGE_CORE_BUNDLE=y
BR2_PACKAGE_KERNEL_BUNDLE=y
BR2_PACKAGE_EXTRA_LIBS_BUNDLE=y
BR2_PACKAGE_NETWORK_BUNDLE=y
BR2_PACKAGE_PYTHON_BUNDLE=y
BR2_PACKAGE_SCIENTIFIC_BUNDLE=y
BR2_PACKAGE_TOOLS_BUNDLE=y
BR2_PACKAGE_WEB_BUNDLE=y
BR2_PACKAGE_RPI_BUNDLE=y
```
